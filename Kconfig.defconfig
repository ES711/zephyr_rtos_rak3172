## Kconfig.defconfig
```kconfig
# RAK3172 board configuration

if BOARD_RAK3172

config BOARD
    default "rak3172"

# Uart configuration
config UART_CONSOLE
    default y
    depends on SERIAL

# GPIO configuration
config GPIO
    default y

# LoRa configuration
if LORA
config LORA_SHELL
    default y
endif # LORA

endif # BOARD_RAK3172
```

## Kconfig.rak3172
```kconfig
config BOARD_RAK3172
    bool "RAK3172 Evaluation Board"
    select SOC_STM32WLE5XX
```

## rak3172_defconfig
```kconfig
# Enable MPU
CONFIG_ARM_MPU=y

# Enable hardware stack protection
CONFIG_HW_STACK_PROTECTION=y

# Enable uart driver
CONFIG_SERIAL=y
CONFIG_UART_LINE_CTRL=y

# Enable console
CONFIG_CONSOLE=y
CONFIG_UART_CONSOLE=y

# Enable GPIO
CONFIG_GPIO=y

# Enable Pin Controller
CONFIG_PINCTRL=y

# Enable IO Communication
CONFIG_SPI=y
CONFIG_I2C=y

# Adjust stack size
CONFIG_MAIN_STACK_SIZE=2048
CONFIG_SYSTEM_WORKQUEUE_STACK_SIZE=2048

# Enable shell (required by LoRa)
# CONFIG_SHELL=y
# CONFIG_SHELL_MINIMAL=y
# CONFIG_SHELL_BACKEND_SERIAL=y

# Enable LoRa
# CONFIG_LORA=y
# CONFIG_LORA_SHELL=y
# CONFIG_LORA_STM32WL_SUBGHZ_RADIO=y

# Enable LoRaWan
# CONFIG_LORAWAN=y
# CONFIG_LORAWAN_LOG_LEVEL_DBG=y
# CONFIG_LORAMAC_REGION_AS923=y
```

## rak_3172_defconfig
```kconfig
# enable uart driver
CONFIG_SERIAL=y

# enable GPIO
CONFIG_GPIO=y

# console
CONFIG_CONSOLE=y
CONFIG_UART_CONSOLE=y

# Enable MPU
CONFIG_ARM_MPU=y

# Enable HW stack protection
CONFIG_HW_STACK_PROTECTION=y

CONFIG_PINCTRL=y

CONFIG_LORA_STM32WL_SUBGHZ_RADIO=y
CONFIG_LORAWAN=y
CONFIG_LORAWAN_LOG_LEVEL_DBG=y
CONFIG_LORAMAC_REGION_AS923=y
CONFIG_MAIN_STACK_SIZE=2048
CONFIG_SYSTEM_WORKQUEUE_STACK_SIZE=2048
```
